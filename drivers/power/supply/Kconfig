## drivers/power/supply/Kconfig
```kconfig
config POWER_QCOM_LEGACY
	bool "Legacy QC power supply drivers"
	help
	  Say Y here to use legacy power supply drivers for QC
	  SoCs. Those drivers are needed for MSM8996, 8976 and
	  other legacy SoCs.

if POWER_QCOM_LEGACY
source "drivers/power/supply/qcom_legacy/Kconfig"
endif

if !POWER_QCOM_LEGACY
source "drivers/power/supply/qcom/Kconfig"
endif
```

## drivers/power/supply/qcom_legacy/Kconfig
```kconfig
config QPNP_CHARGER
	tristate "QPNP Charger driver"
	depends on SPMI || MSM_SPMI
 	depends on OF_SPMI
	depends on THERMAL_QPNP_ADC_TM
	help
	  Say Y here to enable the switch mode battery charger
	  and boost device which supports USB detection and charging. The driver
	  also offers relevant information to userspace via the power supply
	  framework.

config QPNP_SMBCHARGER
	tristate "QPNP SMB Charger driver"
	depends on SPMI || MSM_SPMI
	depends on OF_SPMI
	help
	  Say Y here to enable the dual path switch mode battery charger which
	  supports USB detection and battery charging up to 3A.
	  The driver also offers relevant information to userspace via the
	  power supply framework.

config QPNP_SMBCHARGER_EXTENSION
	tristate "Charger driver extension"
	depends on QPNP_SMBCHARGER
	help
	  Say Y here to enable SoMC extensional SMB charger functions.

config QPNP_FG
	tristate "QPNP fuel gauge driver"
	depends on SPMI || MSM_SPMI
	depends on OF_SPMI
	help
	  Say Y here to enable the Fuel Gauge driver. This adds support for
	  battery fuel gauging and state of charge of battery connected to the
	  fuel gauge. The state of charge is reported through a BMS power
	  supply property and also sends uevents when the capacity is updated.

config QPNP_FG_EXTENSION
	tristate "Fuel gauge driver extension"
	depends on QPNP_FG
	help
	  Say Y here to enable SoMC extensional fuel gauge functions.

config QPNP_VM_BMS
	tristate "QPNP Voltage-Mode Battery Monitoring System driver"
	depends on SPMI || MSM_SPMI
	depends on MSM_QPNP_INT
	help
	  Say Y here to enable support for QPNP chip vm-bms device.
	  The voltage-mode (vm) BMS driver uses periodic VBATT
	  readings from the battery to calculate the State of
	  Charge.

config QPNP_BMS
	tristate "QPNP Battery Monitoring System driver"
	depends on SPMI || MSM_SPMI
	depends on MSM_QPNP_INT
	help
	  Say Y here to enable support for QPNP chip bms device.
	  It registers a fuelgauge bms power supply to report
	  State of Charge.

config QPNP_LINEAR_CHARGER
	tristate "QPNP Linear Charger driver"
	depends on SPMI || MSM_SPMI
	depends on OF_SPMI
	depends on MSM_QPNP_INT
	depends on THERMAL_QPNP_ADC_TM
	help
	  Say Y here to enable the Linear battery charger which supports USB
	  detection and charging. The driver also offers relevant information
	  to userspace via the power supply framework.

config QPNP_TYPEC
	tristate "QPNP Type-C driver"
	depends on SPMI || MSM_SPMI
	depends on OF_SPMI
	depends on MSM_QPNP_INT
	help
	  Say Y here to enable QPNP Type-C driver.
	  The QPNP Type-C module supports the USB type-C protocol. It supports type-C
	  cable detection and other type-C parameters such as current-capability and
	  CC-orientation. The module does not support USB power-delivery. The driver
	  adds support to report these type-C parameters via the power-supply
	  framework.
```
